VERSION "Harness Resistance Demo"
NS_ :

BS_:

BU_ ECU_A ECU_B DCDC

BO_ 273 ECU_A_STATUS: 8 ECU_A
 SG_ ECUA_Supply_Voltage : 0|16@1+ (0.1,0) [0|40] "V"  ECU_A

BO_ 274 ECU_B_STATUS: 8 ECU_B
 SG_ ECUB_Supply_Voltage : 0|16@1+ (0.1,0) [0|40] "V"  ECU_B

BO_ 275 DCDC_STATUS: 8 DCDC
 SG_ DCDC_Output_Voltage : 0|16@1+ (0.1,0) [0|40] "V"  DCDC
